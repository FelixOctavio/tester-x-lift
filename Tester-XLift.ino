#include <Adafruit_BusIO_Register.h>
#include <Adafruit_I2CDevice.h>
#include <Adafruit_I2CRegister.h>
#include <Adafruit_SPIDevice.h>

#include <Adafruit_SSD1306.h>
#include <splash.h>

#include <Adafruit_GFX.h>
#include <Adafruit_GrayOLED.h>
#include <Adafruit_SPITFT.h>
#include <Adafruit_SPITFT_Macros.h>
#include <gfxfont.h>

#define SCREEN_WIDTH 128 // OLED display width, in pixels
#define SCREEN_HEIGHT 64 // OLED display height, in pixels

// Declaration for an SSD1306 display connected to I2C (SDA, SCL pins)
#define OLED_RESET     -1 // Reset pin # (or -1 if sharing Arduino reset pin)
Adafruit_SSD1306 display(SCREEN_WIDTH, SCREEN_HEIGHT, &Wire, OLED_RESET);

#define NUMFLAKES     10 // Number of snowflakes in the animation example

#define LOGO_HEIGHT   64
#define LOGO_WIDTH    128

// 'Chinosaurus', 128x64px
const unsigned char logo_bmp [] PROGMEM = {
	0x00, 0x00, 0x00, 0x00, 0x00, 0x00, 0x00, 0x00, 0x00, 0x00, 0x00, 0x00, 0x00, 0x00, 0x00, 0x00, 
	0x00, 0x00, 0x00, 0x00, 0x00, 0x00, 0x78, 0x00, 0x00, 0x00, 0x00, 0x00, 0x00, 0x00, 0x00, 0x00, 
	0x00, 0x00, 0x00, 0x00, 0x00, 0x00, 0x7e, 0x00, 0x00, 0x00, 0x00, 0x00, 0x00, 0x00, 0x00, 0x00, 
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	0x00, 0x00, 0x00, 0x00, 0x00, 0x00, 0x00, 0x00, 0x00, 0x00, 0x00, 0x00, 0x00, 0x00, 0x00, 0x00
};



int biru = 6;
int hijau = 5;
int kuning = 4;
int merah = 3;

int tomBiru = 13;
int tomHijau = 12;
int tomKuning = 11;
int tomMerah = 10;

int timeDelay = 100;

int pertama = 0;

unsigned long timBiru = 0;
unsigned long timHijau = 0;
unsigned long timKuning = 0;
unsigned long timMerah = 0;

void setup() {
  pinMode(biru, OUTPUT);
  pinMode(hijau, OUTPUT);
  pinMode(kuning, OUTPUT);
  pinMode(merah, OUTPUT);

  pinMode(tomBiru, INPUT_PULLUP);
  pinMode(tomHijau, INPUT_PULLUP);
  pinMode(tomKuning, INPUT_PULLUP);
  pinMode(tomMerah, INPUT_PULLUP);

  // SSD1306_SWITCHCAPVCC = generate display voltage from 3.3V internally
  if(!display.begin(SSD1306_SWITCHCAPVCC, 0x3C)) { 
    Serial.println(F("SSD1306 allocation failed"));
    for(;;); // Don't proceed, loop forever
  }

  // testdrawbitmap();
}

void loop() {
  timer_display();
  if (pertama == 0) {
    start();
    pertama = 1;
  }

  if (digitalRead(tomBiru) == LOW) {
    if (timBiru == 0) {
      timBiru = millis();
      digitalWrite(biru, HIGH);
    }
  } else {
    if ( millis() - timBiru > 5000 ) {
      digitalWrite(biru, LOW);
      timBiru = 0;
    }
  }

  if (digitalRead(tomHijau) == LOW) {
    if (timHijau == 0) {
      timHijau = millis();
      digitalWrite(hijau, HIGH);
    }
  } else {
    if ( millis() - timHijau > 5000 ) {
      digitalWrite(hijau, LOW);
      timHijau = 0;
    }
  }

  if (digitalRead(tomKuning) == LOW) {
    if (timKuning == 0) {
      timKuning = millis();
      digitalWrite(kuning, HIGH);
    }
  } else {
    if ( millis() - timKuning > 5000 ) {
      digitalWrite(kuning, LOW);
      timKuning = 0;
    }
  }

  if (digitalRead(tomMerah) == LOW) {
    if (timMerah == 0) {
      timMerah = millis();
      digitalWrite(merah, HIGH);
    }
  } else {
    if ( millis() - timMerah > 5000 ) {
      digitalWrite(merah, LOW);
      timMerah = 0;
    }
  }
}

void start() {
  digitalWrite(biru, HIGH);
  delay(timeDelay); 
  digitalWrite(biru, LOW);
  digitalWrite(hijau, HIGH);
  delay(timeDelay);
  digitalWrite(hijau, LOW);
  digitalWrite(kuning, HIGH);
  delay(timeDelay); 
  digitalWrite(kuning, LOW);
  digitalWrite(merah, HIGH);
  delay(timeDelay);
  digitalWrite(merah, LOW);

  digitalWrite(biru, HIGH);
  digitalWrite(hijau, HIGH);
  digitalWrite(kuning, HIGH);
  digitalWrite(merah, HIGH);

  delay(500);

  digitalWrite(biru, LOW);
  digitalWrite(hijau, LOW);
  digitalWrite(kuning, LOW);
  digitalWrite(merah, LOW);
}

void testdrawbitmap(void) {
  display.clearDisplay();

  display.drawBitmap(
    (display.width()  - LOGO_WIDTH ) / 2,
    (display.height() - LOGO_HEIGHT) / 2,
    logo_bmp, LOGO_WIDTH, LOGO_HEIGHT, 1);
  display.display();
  delay(1000);
}

void timer_display() {
  char LCDmsg[17];
  display.clearDisplay();
  display.setTextSize(1);
  display.setTextColor(WHITE);
  display.setCursor(0,10);
  display.println("X-Lift Tester");

  display.setCursor(0,25);  
  if (timMerah != 0) {
    if (millis() - timMerah >= 0 && millis() - timMerah < 1000) {
      sprintf(LCDmsg, "1: Pressed (5)");
    } else if (millis() - timMerah >= 1000 && millis() - timMerah < 2000) {
      sprintf(LCDmsg, "1: Pressed (4)");
    } else if (millis() - timMerah >= 2000 && millis() - timMerah < 3000) {
      sprintf(LCDmsg, "1: Pressed (3)");
    } else if (millis() - timMerah >= 3000 && millis() - timMerah < 4000) {
      sprintf(LCDmsg, "1: Pressed (2)");
    } else if (millis() - timMerah >= 4000 && millis() - timMerah < 5000) {
      sprintf(LCDmsg, "1: Pressed (1)");
    }
   } else sprintf(LCDmsg, "1: -");
  display.println(LCDmsg);
  display.setCursor(0,35);  
  if (timKuning != 0) {
    if (millis() - timKuning >= 0 && millis() - timKuning < 1000) {
      sprintf(LCDmsg, "2: Pressed (5)");
    } else if (millis() - timKuning >= 1000 && millis() - timKuning < 2000) {
      sprintf(LCDmsg, "2: Pressed (4)");
    } else if (millis() - timKuning >= 2000 && millis() - timKuning < 3000) {
      sprintf(LCDmsg, "2: Pressed (3)");
    } else if (millis() - timKuning >= 3000 && millis() - timKuning < 4000) {
      sprintf(LCDmsg, "2: Pressed (2)");
    } else if (millis() - timKuning >= 4000 && millis() - timKuning < 5000) {
      sprintf(LCDmsg, "2: Pressed (1)");
    }
  } else sprintf(LCDmsg, "2: -");
  display.println(LCDmsg);
  display.setCursor(0,45);  
  if (timHijau != 0) {
    if (millis() - timHijau >= 0 && millis() - timHijau < 1000) {
      sprintf(LCDmsg, "3: Pressed (5)");
    } else if (millis() - timHijau >= 1000 && millis() - timHijau < 2000) {
      sprintf(LCDmsg, "3: Pressed (4)");
    } else if (millis() - timHijau >= 2000 && millis() - timHijau < 3000) {
      sprintf(LCDmsg, "3: Pressed (3)");
    } else if (millis() - timHijau >= 3000 && millis() - timHijau < 4000) {
      sprintf(LCDmsg, "3: Pressed (2)");
    } else if (millis() - timHijau >= 4000 && millis() - timHijau < 5000) {
      sprintf(LCDmsg, "3: Pressed (1)");
    }
  } else sprintf(LCDmsg, "3: -");
  display.println(LCDmsg);
  display.setCursor(0,55);  
  if (timBiru != 0) {
    if (millis() - timBiru >= 0 && millis() - timBiru < 1000) {
      sprintf(LCDmsg, "4: Pressed (5)");
    } else if (millis() - timBiru >= 1000 && millis() - timBiru < 2000) {
      sprintf(LCDmsg, "4: Pressed (4)");
    } else if (millis() - timBiru >= 2000 && millis() - timBiru < 3000) {
      sprintf(LCDmsg, "4: Pressed (3)");
    } else if (millis() - timBiru >= 3000 && millis() - timBiru < 4000) {
      sprintf(LCDmsg, "4: Pressed (2)");
    } else if (millis() - timBiru >= 4000 && millis() - timBiru < 5000) {
      sprintf(LCDmsg, "4: Pressed (1)");
    }
  } else sprintf(LCDmsg, "4: -");
  display.println(LCDmsg);
  display.display();
}